/*****************************************************************************************************************//**
* @file         rom
* @brief        EEPROM Programmer for the lower ROM chips 
* @author       Adam Clark
*
* This code will include the lower ROM binary array and add it into this source.  It will then write to the ROM 
* using the Arduino to accomplish the write.
* 
*///==================================================================================================================



/*****************************************************************************************************************//**
* The following section is the common code used to program the EEPROM.  This section will be repeated with each 
* separate piece of firmware (at least unless/until I can figure out how to tell the Arduino IDE to import something
* from another folder).
* 
* In the meantime, I expect to have to do multiple-maintenance on anything in this section.
*///==================================================================================================================



//
// -- Define some constants that will be used to interact with the Arduino
//    --------------------------------------------------------------------
#define PIN_DATA    2
#define PIN_CLOCK   3
#define READ_BYTE   4
#define CHIP_ENAB   5
#define WRITE_BYTE  6

#define DATA0       8
#define DATA7       15


#define ROM_BYTES   8192


//
// -- Set an address to be read from/written to
//    -----------------------------------------
void setAddress(int address) {
  address &= 0x1fff;       // safety first -- make sure the address is only 13 bits wide
  digitalWrite(WRITE_BYTE, HIGH);
  digitalWrite(READ_BYTE, HIGH);
  
  shiftOut(PIN_DATA, PIN_CLOCK, MSBFIRST, address >> 8);
  shiftOut(PIN_DATA, PIN_CLOCK, MSBFIRST, address & 0xff);

  delay(1000);
}


//
// -- Write a single byte of data to an address in the EEPROM
//    -------------------------------------------------------
void writeEeprom(int address, byte data) {
  setAddress(address);

  for (int pin = DATA7; pin >= DATA0; pin --) {
    pinMode(pin, OUTPUT);
  }

  digitalWrite(WRITE_BYTE, LOW);

  for (int pin = DATA7; pin >= DATA0; pin --) {
    digitalWrite(pin, data & 1);
    data = data >> 1;
  }

  delayMicroseconds(10);
  
  digitalWrite(WRITE_BYTE, HIGH);
  delay(50);
}



//
// -- Read a single byte from an address on the EEPROM
//    ------------------------------------------------
byte readEeprom(int address) {
  setAddress(address);
  
  for (int pin = DATA0; pin <= DATA7; pin ++) {
    pinMode(pin, INPUT);
  }

  byte data = 0;

  digitalWrite(READ_BYTE, LOW);
  delayMicroseconds(10);

  for (int pin = DATA0; pin <= DATA7; pin ++) {
    data = (data << 1) | digitalRead(pin);
  }

//  digitalWrite(READ_BYTE, HIGH);

  return data;
}


//
// -- Dump the contents of the entire EEPROM to the Serial Port
//    ---------------------------------------------------------
void dumpEeprom(void) {
  char buf [80];
  
  Serial.println();
  Serial.println("Dumping the contents of the Eeprom\n");
  Serial.println();
  Serial.println("       0x00 0x01 0x02 0x03 0x04 0x05 0x06 0x07   0x08 0x09 0x0a 0x0b 0x0c 0x0d 0x0e 0x0f");
  Serial.println("       ---- ---- ---- ---- ---- ---- ---- ----   ---- ---- ---- ---- ---- ---- ---- ----");

  for (int base = 0; base < ROM_BYTES; base += 16) {
    sprintf(buf, "0x%03x: ", base);
    Serial.print(buf);

    for (int offset = 0; offset < 16; offset ++) {
      int addr = base + offset;
      sprintf(buf, "0x%02x ", readEeprom(addr));
      Serial.print(buf);

      if (offset == 7) Serial.print("  ");
    }

    Serial.println();
  }
}


//
// -- Erase the EEPROM back to factory (burns one of the write cycles)
//    ----------------------------------------------------------------
void eraseEeprom(void) {
  Serial.print("Erasing EEPROM");
  
  for (int i = 0; i < ROM_BYTES; i ++) {
    writeEeprom(i, 0xff);
    
    if (i % 32 == 0) Serial.print(".");
  }

  Serial.println();
}



//
// -- Perform the EEPROM programmer initialization
//    --------------------------------------------
void performInitialization() {
  digitalWrite(PIN_CLOCK, LOW);
  digitalWrite(PIN_DATA, LOW);
  digitalWrite(WRITE_BYTE, HIGH);
  digitalWrite(READ_BYTE, HIGH);
  digitalWrite(CHIP_ENAB, HIGH);

  pinMode(PIN_DATA, OUTPUT);
  pinMode(PIN_CLOCK, OUTPUT);
  pinMode(READ_BYTE, OUTPUT);
  pinMode(WRITE_BYTE, OUTPUT);
  pinMode(CHIP_ENAB, OUTPUT);
}



/*****************************************************************************************************************//**
* The following section is directly the task to complete.  
* 
* In this case, we are going to program the ROM with its binary data.
*///==================================================================================================================


const uint8_t romData[] PROGMEM = {
    0x01, 0x02, 0x04, 0x08, 0x10, 0x20, 0x40, 0x80, 0x40,
    0x20, 0x10, 0x08, 0x04, 0x02, 0x01, 0x02, 0x04, 0x08,
    0x10, 0x20, 0x40, 0x80, 0x40, 0x20, 0x10, 0x08, 0x04, 
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    0x40, 0x80, 0x40, 0x20, 0x10, 0x08, 0x04, 0x02, 0x01, 
};



//
// -- Complete the EEPROM programming
//    -------------------------------
void programEeprom() {
    int addr;
  
    for (addr = 0; addr < sizeof(romData); addr ++) {
        if ((addr & 0xfff) == 0) {
            Serial.println();
            Serial.print(addr);
            Serial.print(": ");
        }
        if ((addr & 0xff) == 0) Serial.print(".");
        writeEeprom(addr, pgm_read_byte_near(romData + addr));
    }


    for ( ; addr < ROM_BYTES; addr ++) {
        if ((addr & 0xfff) == 0) {
            Serial.println();
            Serial.print(addr);
            Serial.print(": ");
        }
        if ((addr & 0xff) == 0) Serial.print(".");
        writeEeprom(addr, -1);
    }
}


//
// -- Perform a special write sequence for the SDP commands
//    -----------------------------------------------------
void sdpWrite(int address, byte data) {
  setAddress(address);

  for (int pin = DATA7; pin >= DATA0; pin --) {
    pinMode(pin, OUTPUT);
  }

  for (int pin = DATA7; pin >= DATA0; pin --) {
    digitalWrite(pin, data & 1);
    data = data >> 1;
  }

  digitalWrite(CHIP_ENAB, LOW);
  digitalWrite(WRITE_BYTE, LOW);
  delayMicroseconds(1);
  digitalWrite(WRITE_BYTE, HIGH);
  digitalWrite(CHIP_ENAB, HIGH);
  delayMicroseconds(1);
}





void disableSoftwareDataProtection(void) {
  Serial.println(".. Attempting to being the chip out of write-protect mode");

  digitalWrite(READ_BYTE, HIGH);
  digitalWrite(WRITE_BYTE, HIGH);
  digitalWrite(CHIP_ENAB, HIGH);

  delay(10);
  
  sdpWrite(0x1555, 0xaa);
  sdpWrite(0x0aaa, 0x55);
  sdpWrite(0x1555, 0x80);
  sdpWrite(0x1555, 0xaa);
  sdpWrite(0x0aaa, 0x55);
  sdpWrite(0x1555, 0x20);

  Serial.println(".. Done (good luck!)");
  digitalWrite(CHIP_ENAB, LOW);
}



//
// -- Standard Setup function
//    -----------------------
void setup() {
  performInitialization();

  Serial.begin(57600);
  Serial.println("Welcome to the ROM-BIOS/BASIC EEPROM Programmer");
  Serial.println("  This software will program the firmware for the ROM Memory");

  disableSoftwareDataProtection();

  writeEeprom(0x1234, 0b11010101);
  Serial.println();

  delay(2000);

  
  Serial.println(readEeprom(0x1234));
//  Serial.println(readEeprom(0));
//  Serial.println(readEeprom(0));
//  Serial.println(readEeprom(0));
//  Serial.println(readEeprom(0));
//  programEeprom();
//  dumpEeprom();
  Serial.println();
  Serial.println("All done!");
}


//
// -- Standard post-initialization loop function
//    ------------------------------------------
void loop() {
  // -- nothing to do here; what we want to do should not be in a loop
}
